## app/boards/shields/bugbearzmnright/Kconfig.defconfig
```kconfig
# Copyright (c) 2025 Robin Gosse
# SPDX-License-Identifier: MIT

if SHIELD_BUGBEARZMNRIGHT

config ZMK_KEYBOARD_NAME
    default "BugBear ZMK Right"

endif
```

## app/boards/shields/bugbearzmnright/Kconfig.shield
```kconfig
# Copyright (c) 2025 Robin Gosse
# SPDX-License-Identifier: MIT

config SHIELD_BUGBEARZMNRIGHT
    def_bool $(shields_list_contains,bugbearzmnright)
    select PS2
    select PS2_MOUSE
    select ZMK_INPUT_MOUSE
```

## app/west.yml
```yaml
manifest:
  remotes:
    - name: zephyrproject-rtos
      url-base: https://github.com/zephyrproject-rtos
    - name: zmkfirmware
      url-base: https://github.com/zmkfirmware
    - name: infused-kim
      url-base: https://github.com/infused-kim
      
  projects:
    # ==========================================================================
    # ZEPHYR RTOS - Keep your existing version
    # ==========================================================================
    - name: zephyr
      remote: zmkfirmware
      revision: v4.1.0+zmk-fixes
      clone-depth: 1
      import:
        name-blocklist:
          - ci-tools
          - hal_altera
          - hal_cypress
          - hal_infineon
          - hal_microchip
          - hal_nxp
          - hal_openisa
          - hal_xtensa
          - hal_st
          - hal_ti
          - loramac-node
          - mcuboot
          - mcumgr
          - net-tools
          - openthread
          - edtt
          - trusted-firmware-m
          
    # ==========================================================================
    # HAL MODULES - Keep existing
    # ==========================================================================
    - name: hal_stm32
      revision: 4fcc3a3f32abe1c4cb76d9d1cef967728dd03908
      path: modules/hal/stm32
      remote: zmkfirmware
      groups:
        - hal
        
    # ==========================================================================
    # LVGL - Keep existing
    # ==========================================================================
    - name: lvgl
      revision: f1db87ee98f1810328a8419572fa42a3b5f352ae
      path: modules/lib/gui/lvgl
      remote: zmkfirmware
      
    # ==========================================================================
    # ZMK STUDIO - Keep existing
    # ==========================================================================
    - name: zmk-studio-messages
      revision: 6cb4c283e76209d59c45fbcb218800cd19e9339d
      path: modules/msgs/zmk-studio-messages
      remote: zmkfirmware
      
    # ==========================================================================
    # PS/2 TRACKPOINT DRIVER MODULE - Keep existing (this is correct!)
    # ==========================================================================
    - name: kb_zmk_ps2_mouse_trackpoint_driver
      remote: infused-kim
      revision: main
      path: modules/drivers/ps2
      
  group-filter: [+optional]
  
  self:
    west-commands: scripts/west-commands.yml


# ==============================================================================
# CRITICAL PROBLEM IDENTIFIED
# ==============================================================================
#
# Your west.yml structure shows you're building ZMK directly (not using zmk-config).
# This means you're IN the ZMK repository itself.
#
# THE ISSUE: You're using zmkfirmware/zmk which does NOT have mouse support!
#
# You need to be in a ZMK FORK that has mouse pointer support merged.
#
# SOLUTION: Clone the correct ZMK repository instead
#
# Instead of:
#   git clone https://github.com/zmkfirmware/zmk.git
#
# Use one of these:
#   git clone https://github.com/infused-kim/zmk.git
#   git checkout pr-testing/mouse_ps2_module_base
#
# OR:
#   git clone https://github.com/petejohanson/zmk.git
#   git checkout feat/pointers-move-scroll
#
# Then your west.yml above will work!
#
# ==============================================================================
```
